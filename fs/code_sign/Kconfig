## fs/code_sign/Kconfig
```kconfig
# SPDX-License-Identifier: GPL-2.0-or-later
# Copyright (c) 2023 Huawei Device Co., Ltd.
#
config SECURITY_CODE_SIGN
	bool "Advanced code signing features based on FS Verity"
	depends on FS_VERITY
	default n
	help
	  This option enables additional code signing features based
	  on fs-verity, such as 1) protecting part of file to support
	  carried signature and Merkle tree, 2) verifying if a signing
	  certificate can be trusted, etc.

	  If unsure, say N.
```
